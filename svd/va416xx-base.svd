# va416xx register map
Vendor: VORAGO TECHNOLOGIES; Series: M4; File version: 1.3
ARM 32-bit Cortex-M4 Microcontroller based device, CPU clock up to 100MHz
CPU: CM4 r0p1, little endian, no MPU, FPU, 4 interrupt priority bits
Registers are 32-bit, read-write, reset 0x0 unless marked. A register's access mark holds for its fields unless they carry their own. Offsets are from the block's base; lines under a group give offsets from that group; [hi:lo] are bit positions; {n}, {i} and the like mark numbered series; 'fields as' and 'values as' point back to an identical list; <NAME> marks a mode.

## Memory map
0x40001000 DMA size 0x1000 — DMA Controller Block
0x40002000 IRQ_ROUTER size 0x1000 — Interrupt Router Peripheral
0x40003000 SPW size 0x400 — SpaceWire Peripheral
0x40004000 ETH size 0x2000 — Ethernet Block
0x40006000 CLKGEN size 0x100 — Clock Generation Peripheral
0x40010000 SYSCONFIG size 0x1000 — System Configuration Peripheral
0x40011000 IOCONFIG size 0x1000 — IO Pin Configuration Peripheral
0x40012000 PORTA size 0x400 — GPIO Peripheral
0x40012400 PORTB size 0x400
0x40012800 PORTC size 0x400
0x40012C00 PORTD size 0x400
0x40013000 PORTE size 0x400
0x40013400 PORTF size 0x400
0x40013800 PORTG size 0x400
0x40014000 CAN0 size 0x400 — CAN Peripheral
0x40014400 CAN1 size 0x400
0x40015000 SPI0 size 0x400 — SPI Peripheral
0x40015400 SPI1 size 0x400
0x40015800 SPI2 size 0x400
0x40015C00 SPI3 size 0x400
0x40016000 I2C0 size 0x400 — I2C Peripheral
0x40016400 I2C1 size 0x400
0x40016800 I2C2 size 0x400
0x40017000 UART2 size 0x1000
0x40018000 TIM0 size 0x400 — Timer/Counter Peripheral
{0x40018000+0x400*n} TIM{n} size 0x400 (n=1..15)
0x40020000 UTILITY size 0x1000 — Utility Peripheral
0x40021000 WATCH_DOG size 0x1000 — Watchdog Block Peripheral
0x40022000 ADC size 0x1000 — Analog to Digital Converter Peripheral
0x40023000 DAC0 size 0x800 — Digital to Analog Converter Peripheral
0x40023800 DAC1 size 0x800
0x40024000 UART0 size 0x1000 — UART Peripheral
0x40025000 UART1 size 0x1000
0x40027000 TRNG size 0x400 — True Random Number Generator
{0x40024000+0x400*n} TIM{n} size 0x400 (n=16..23)

## Interrupts
{n} U{n} (IRQ_ROUTER) (n=0..15)
16 SPI0_TX (SPI0)
17 SPI0_RX (SPI0)
18 SPI1_TX (SPI0)
19 SPI1_RX (SPI0)
20 SPI2_TX (SPI0)
21 SPI2_RX (SPI0)
22 SPI3_TX (SPI0)
23 SPI3_RX (SPI0)
24 UART0_TX (UART0)
25 UART0_RX (UART0)
26 UART1_TX (UART0)
27 UART1_RX (UART0)
28 UART2_TX (UART0)
29 UART2_RX (UART0)
30 I2C0_MS (I2C0)
31 I2C0_SL (I2C0)
32 I2C1_MS (I2C0)
33 I2C1_SL (I2C0)
34 I2C2_MS (I2C0)
35 I2C2_SL (I2C0)
36 Ethernet (ETH)
37 U37 (IRQ_ROUTER)
38 SpW (SPW)
39 U39 (IRQ_ROUTER)
40 DAC0
41 DAC1 (DAC0)
42 TRNG
43 DMA_ERROR (DMA)
44 ADC
45 LoCLK (CLKGEN)
46 LVD (SYSCONFIG)
47 WATCHDOG (WATCH_DOG)
48 TIM0
{n+48} TIM{n} (TIM0) (n=1..23)
72 CAN0
73 U73 (IRQ_ROUTER)
74 CAN1 (CAN0)
75 U75 (IRQ_ROUTER)
76 EDAC_MBE (SYSCONFIG)
77 EDAC_SBE (SYSCONFIG)
{n+78} PORTA{n} (PORTA) (n=0..15)
{n+94} PORTB{n} (PORTA) (n=0..15)
{n+110} PORTC{n} (PORTA) (n=0..15)
{n+126} PORTD{n} (PORTA) (n=0..15)
{n+142} PORTE{n} (PORTA) (n=0..15)
{n+158} PORTF{n} (PORTA) (n=0..15)
174 DMA_ACTIVE0 (DMA)
175 DMA_ACTIVE1 (DMA)
176 DMA_ACTIVE2 (DMA)
177 DMA_ACTIVE3 (DMA)
178 DMA_DONE0 (DMA)
179 DMA_DONE1 (DMA)
180 DMA_DONE2 (DMA)
181 DMA_DONE3 (DMA)
182 I2C0_MS_RX (I2C0)
183 I2C0_MS_TX (I2C0)
184 I2C0_SL_RX (I2C0)
185 I2C0_SL_TX (I2C0)
186 I2C1_MS_RX (I2C0)
187 I2C1_MS_TX (I2C0)
188 I2C1_SL_RX (I2C0)
189 I2C1_SL_TX (I2C0)
190 I2C2_MS_RX (I2C0)
191 I2C2_MS_TX (I2C0)
192 I2C2_SL_RX (I2C0)
193 I2C2_SL_TX (I2C0)
194 FPU (IRQ_ROUTER)
195 TXEV (IRQ_ROUTER)

## Licence text in the file
VORAGO Technologies ---------------------------------------------------------------------------- Copyright (c) 2013-2020 VORAGO Technologies . BY DOWNLOADING, INSTALLING OR USING THIS SOFTWARE, YOU AGREE TO BE BOUND BY ALL THE TERMS. AND CONDITIONS OF THE VORAGO TECHNOLOGIES END USER LICENSE AGREEMENT. . THIS SOFTWARE IS PROVIDED "AS IS". NO WARRANTIES, WHETHER EXPRESS, IMPLIED. OR STATUTORY, INCLUDING, BUT NOT LIMITED TO, IMPLIED WARRANTIES OF. MERCHANTABILITY AND FITNESS FOR A PARTICULAR PURPOSE APPLY TO THIS SOFTWARE. VORAGO TECHNOLOGIES SHALL NOT, IN ANY CIRCUMSTANCES, BE LIABLE. FOR SPECIAL, INCIDENTAL, OR CONSEQUENTIAL DAMAGES, FOR ANY REASON WHATSOEVER.
